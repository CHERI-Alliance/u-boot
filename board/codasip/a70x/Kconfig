## board/codasip/a70x/Kconfig
```kconfig
if TARGET_CODASIP_A70X

config SYS_BOARD
	default "a70x"

config SYS_VENDOR
	default "codasip"

config SYS_CPU
	default "generic"

config SYS_CONFIG_NAME
	default "codasip-a70x"

config TEXT_BASE
	default 0x80000000 if !RISCV_SMODE
	default 0x80200000 if RISCV_SMODE
endif
```

## board/codasip/a730-hobgoblin/Kconfig
```kconfig
if TARGET_CODASIP_A730_HOBGOBLIN || TARGET_CODASIP_A730_HOBGOBLIN_PROFPGA

config SYS_BOARD
	default "a730-hobgoblin"

config SYS_VENDOR
	default "codasip"

config SYS_CPU
	default "generic"

config SYS_CONFIG_NAME
	default "codasip-a730-hobgoblin"

config TEXT_BASE
	default 0x2000000000 if TARGET_CODASIP_A730_HOBGOBLIN_PROFPGA && !RISCV_SMODE
	default 0x2000200000 if TARGET_CODASIP_A730_HOBGOBLIN_PROFPGA && RISCV_SMODE
	default 0x80000000 if TARGET_CODASIP_A730_HOBGOBLIN && !RISCV_SMODE
	default 0x80200000 if TARGET_CODASIP_A730_HOBGOBLIN && RISCV_SMODE

config BOARD_SPECIFIC_OPTIONS # dummy
	def_bool y
	select GENERIC_RISCV
	imply MMC
	imply SPI
	imply MMC_SPI
	imply XILINX_GPIO
	imply GPIO_HOG

endif
```

## configs/codasip-a70x-hobgoblin_secure-boot_cheri_purecap_smode_defconfig
```kconfig
CONFIG_RISCV=y
CONFIG_NR_DRAM_BANKS=1
CONFIG_HAS_CUSTOM_SYS_INIT_SP_ADDR=y
CONFIG_CUSTOM_SYS_INIT_SP_ADDR=0x80200000
CONFIG_DM_GPIO=y
CONFIG_DEFAULT_DEVICE_TREE="codasip-a70x"
CONFIG_SYS_LOAD_ADDR=0x80200000
CONFIG_TARGET_CODASIP_A70X=y
CONFIG_ARCH_RV64I=y
CONFIG_RISCV_SMODE=y
CONFIG_RISCV_ISA_ZCHERIPURECAP=y
CONFIG_RISCV_ISA_ZCHERIHYBRID=y
CONFIG_RISCV_ISA_ZCHERIPURECAP_ABI=y
CONFIG_SHOW_REGS=y
CONFIG_RISCV_PRIV_1_9=y
CONFIG_SYS_MEMTEST_START=0x81000000
CONFIG_SYS_MEMTEST_END=0xbf000000
CONFIG_FIT=y
CONFIG_DISTRO_DEFAULTS=y
CONFIG_BOOTDELAY=3
CONFIG_BOOTCOMMAND="if test -z \"${bootargs}\" ; then setenv bootargs earlycon console=ttyS0,115200 root=/dev/mmcblk0p2 rootdelay=1 ; fi ; booti 0x81000000 - ${fdtcontroladdr}"
CONFIG_USE_PREBOOT=y
CONFIG_PREBOOT="setenv fdt_addr ${fdtcontroladdr}; fdt addr ${fdtcontroladdr};"
CONFIG_MISC_INIT_R=y
CONFIG_CMD_SBI=y
# CONFIG_CMD_SAVEENV is not set
CONFIG_CMD_MEMTEST=y
CONFIG_SYS_ALT_MEMTEST=y
CONFIG_CMD_I2C=y
CONFIG_CMD_MMC=y
CONFIG_CMD_SPI=y
CONFIG_CMD_NFS=y
CONFIG_CMD_TIMER=y
# CONFIG_ISO_PARTITION is not set
CONFIG_OF_BOARD=y
CONFIG_OF_OMIT_DTB=y
CONFIG_DM_I2C=y
CONFIG_SYS_I2C_OCORES=y
# CONFIG_INPUT is not set
CONFIG_MISC=y
CONFIG_I2C_EEPROM=y
# CONFIG_MMC_SPI_CRC_ON is not set
# CONFIG_MMC_HW_PARTITIONING is not set
CONFIG_SPI_FLASH_SPANSION=y
CONFIG_XILINX_EMACLITE=y
CONFIG_SYS_NS16550=y
CONFIG_XILINX_SPI=y
CONFIG_SYSRESET=y
CONFIG_SYSRESET_GPIO=y
# CONFIG_EFI_LOADER is not set
CONFIG_LMB_MAX_REGIONS=8
```
